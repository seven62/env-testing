## .projects/board.yml
```yaml
description: This is a collection of issues to populate all the tasks required to work through a course update or release.

materials:

  - name: Phase 4 - On-demand Assets
    description: |
      Create all assets specific to on-demand delivery
      *owner:* @
      - [ ] create transcripts
      - [ ] learning questions
  
  - name: Phase 3 - Internal Testing & QA
    description: |
      Full testing to confirm everything is working together!
      *owner:* @
      - [ ] test entire course in Strigo-dev
      - [ ] github PR review from >= 3 members @curriculum-dev
      _support and apply fixes during pilot_
      - [ ] content repo - apply release tag
      - [ ] infra repo - apply release tag
      - [ ] move course from 3-Development to (release) 1-Latest!
      - [ ] release notes update
      - [ ] update PMO testing is complete
 
  - name: Phase 2.3 - Slides and Visuals
    description: |
      Update training deck and other visual assests:
      *owner:* @
      - [ ] update slide deck
        - [ ] screenshot updates
        - [ ] version numbers in gslides and comments
        - [ ] chapter links in google slide agenda
      _support and apply fixes during pilot_

  - name: Phase 2.2 - Lab Content
    description: |
      Update module labs steps using starting-point AMI
      *owner:* @
      - [ ] review latest style-guide changes
      - [ ] update course vars
      - [ ] module 1
      - [ ] module 2
      - [ ] module ...
      _support and apply fixes during pilot_

  - name: Phase 2.1 - AMI Update
    description: |
      Create a new starting-point image from latest base build:
      *owner:* @
      - [ ] playbook updates
      - [ ] build test AMI @dev
      - [ ] test the AMI (full stack testing, index, etc.)
      - [ ] create a release candidate
      **Make sure that no class are running before updating the class**
      - [ ] update and share AMI in Strigo 
      - [ ] create internal "-dev" class in Strigo for internal testing

  - name: Phase 1 - Planning and Input
    description: |
      Team feedback gathering and change planning
      *owner:* @
      - [ ] solution/update owner named (confirmed)
      - [ ] GH discussion (announcement) as RFC
        - [ ] share in `#education` + email
        - [ ] allow 2 weeks input gathering
      - [ ] updates and outline finalized
        - [ ] define AMI requirements
        - [ ] define significant module changes
      - share finalized update doc to discussion
        - [ ] link in slack
        - [ ] email digest

# this is used to set up a project board with issues turned into cards
board:
  name: '[ COURSE ] curriculum update - v#.#'
  description: '@curriclum-dev workflow to update content'
  columns:
    - TODO
    - DOING
    - DONE
```
